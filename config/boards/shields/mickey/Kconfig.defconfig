## config/boards/shields/mickey/Kconfig.defconfig
```kconfig
if SHIELD_MICKEY_DONGLE

config ZMK_KEYBOARD_NAME
	default "Mickey Dongle"
	
config ZMK_SPLIT_BLE_ROLE_CENTRAL
	default y
	
config ZMK_USB
	default y

config ZMK_POINTING
    default y

# Set this to the number of peripherals your dongle will have.
# For a unibody, this would be 1. If you have left and right halves, set it to 2, etc.
config ZMK_SPLIT_BLE_CENTRAL_PERIPHERALS
    default 1

# Set this to ZMK_SPLIT_BLE_CENTRAL_PERIPHERALS + your desired number of BT profiles (default is 5)
config BT_MAX_CONN
    default 6

# Set this to the same number as BT_MAX_CONN
config BT_MAX_PAIRED
    default 6
endif


if SHIELD_MICKEY

config ZMK_KEYBOARD_NAME
    default "mickey"

endif
```

## config/boards/shields/mickey/Kconfig.shield
```kconfig
config SHIELD_MICKEY
    def_bool $(shields_list_contains,mickey)
config SHIELD_MICKEY_DONGLE
	def_bool $(shields_list_contains,mickey_dongle)
```
