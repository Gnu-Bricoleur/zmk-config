#include <dt-bindings/zmk/matrix_transform.h>

/ {
    chosen {
        zmk,kscan = &default_kscan;
		zmk,input-listener = mouse_input_listener;
    };

	
	default_kscan: kscan {
        compatible = "zmk,kscan-gpio-direct";
        label = "default_kscan";

        input-gpios =
            <&xiao_d 0 (GPIO_ACTIVE_LOW | GPIO_PULL_UP)>,
            <&xiao_d 1 (GPIO_ACTIVE_LOW | GPIO_PULL_UP)>,
            <&xiao_d 2 (GPIO_ACTIVE_LOW | GPIO_PULL_UP)>,
            <&xiao_d 3 (GPIO_ACTIVE_LOW | GPIO_PULL_UP)>;
    };
	
	
	mouse_input_listener {
		compatible = "zmk,input-listener";
		device = <&pd0>;
	};
};
