#include <behaviors.dtsi>
#include <dt-bindings/zmk/keys.h>
#include <dt-bindings/zmk/bt.h>
#include <dt-bindings/zmk/outputs.h>
#include <dt-bindings/zmk/pointing.h>



/ {
    keymap {
	
		m_v: mouse_move {
                        compatible = "zmk,behavior-input-two-axis";
                        #binding-cells = <1>;
                        trigger-period-ms = <12>; // slow down for OTA, default is 3ms
                        x-input-code = <INPUT_REL_X>;
                        y-input-code = <INPUT_REL_Y>;
                        time-to-max-speed-ms = <300>;
                        acceleration-exponent = <1>;
                };
		
        compatible = "zmk,keymap";
		
        default_layer {
            bindings = <
                &bt BT_CLR_ALL  &kp A  &kp B  &kp C 
            >;
        };
    };
};